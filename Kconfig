## Kconfig
```kconfig
# Read by ESP-IDF as a component Kconfig, and by both forges' `make menu`
# (scripts/menu.py) for the IMU_<CHIP> prompts. stm-forge has no Kconfig
# build step: its build only sees the defconfig lines, as
# -DCONFIG_IMU_<CHIP>=1 or 0. Every chip is off unless set.
# Outside ESP-IDF, CMakeLists.txt takes its options from the bool entries
# here, found by their type line: keep `bool` directly under each `config`.
menuconfig IMU
    bool "IMU subsystem"
    default y
    help
        The imu core: struct imu_dev, imu_read() and the imu_* log
        helpers. Pick the chip drivers you need below; none is built by
        default, so a chip missing from sdkconfig is off.

if IMU

    config IMU_MPU6050
        bool "InvenSense MPU-6050 (I2C)"
        default n
        help
            Build the MPU-6050 driver: mpu6050_probe() and friends.

    config IMU_ICM45686
        bool "TDK InvenSense ICM-45686 (SPI)"
        default n
        help
            Build the ICM-45686 driver: icm45686_probe() and friends.

    config IMU_BMI088
        bool "Bosch BMI088 (I2C or SPI)"
        default n
        help
            Build the BMI088 driver: bmi088_probe_i2c(), bmi088_probe_spi()
            and friends. On the STM32 HAL it needs both the I2C and the SPI
            module.

    config IMU_WT901
        bool "WitMotion WT901C-TTL (serial)"
        default n
        help
            Build the WT901 driver: wt901_probe() and friends, reading the
            module's frame stream on a UART the app has set up. On the
            STM32 HAL it needs the UART module.

    config IMU_ICM42688
        bool "TDK InvenSense ICM-42688-P (I2C or SPI)"
        default n
        help
            Build the ICM-42688-P driver: icm42688_probe_i2c(),
            icm42688_probe_spi() and friends. On the STM32 HAL each probe
            is built with its own module, I2C or SPI; one of them is
            needed.

    config IMU_BMI270
        bool "Bosch BMI270 (I2C or SPI)"
        default n
        help
            Build the BMI270 driver: bmi270_probe_i2c(), bmi270_probe_spi()
            and friends, with Bosch's 8 KB configuration file the chip
            needs uploaded at every start (BSD-3-Clause, see NOTICE). On
            the STM32 HAL each probe is built with its own module, I2C or
            SPI; one of them is needed.

    config IMU_JY901
        bool "WitMotion JY901 (serial or I2C)"
        default n
        help
            Build the JY901 driver: jy901_probe_uart(), jy901_probe_i2c()
            and friends, reading the module's frame stream on a UART or its
            registers on I2C. On the STM32 HAL each probe is built with its
            own module, UART or I2C; one of them is needed.

    config IMU_LIS2DH12
        bool "ST LIS2DH12 accelerometer (I2C)"
        default n
        help
            Build the LIS2DH12 driver: lis2dh12_probe_i2c() and friends,
            with its motion detector on INT1. Accelerometer only: imu_read()
            gives NaN for the gyroscope and the temperature. On the STM32
            HAL it needs the I2C module.

    config IMU_DEBUG
        bool "imu_dbg() lines"
        default n
        help
            STM32 HAL only: compile imu_dbg() lines in. On ESP-IDF imu_dbg()
            is ESP_LOGD and the log level decides.

endif # IMU
```
